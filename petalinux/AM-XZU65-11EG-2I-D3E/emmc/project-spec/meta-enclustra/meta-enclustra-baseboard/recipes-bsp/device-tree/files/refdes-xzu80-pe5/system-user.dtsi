/include/ "system-conf.dtsi"
/ {
	model = "Enclustra XZU80 SOM";
};
#include "zynqmp_enclustra_common.dtsi"
#include "zynqmp_enclustra_andromeda_xzu80.dtsi"
#include "zynqmp_enclustra_andromeda_pe5.dtsi"
