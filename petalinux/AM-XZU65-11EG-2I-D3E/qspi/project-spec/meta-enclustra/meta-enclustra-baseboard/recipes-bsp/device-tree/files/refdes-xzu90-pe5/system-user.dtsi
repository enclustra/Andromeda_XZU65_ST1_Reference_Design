/include/ "system-conf.dtsi"
/ {
	model = "Enclustra XZU90 SOM";
};
#include "zynqmp_enclustra_common.dtsi"
#include "zynqmp_enclustra_andromeda_xzu90.dtsi"
#include "zynqmp_enclustra_andromeda_pe5.dtsi"
