/include/ "system-conf.dtsi"
/ {
	model = "Enclustra AM-XZU65-11EG-2I-D3E SOM";
};
#include "zynqmp_enclustra_common.dtsi"
#include "zynqmp_enclustra_andromeda_xzu65.dtsi"
#include "zynqmp_enclustra_mercury_st1.dtsi"
