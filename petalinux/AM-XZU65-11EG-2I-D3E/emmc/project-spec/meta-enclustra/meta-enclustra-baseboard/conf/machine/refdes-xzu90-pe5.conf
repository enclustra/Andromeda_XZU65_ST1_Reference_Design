## petalinux/AM-XZU65-11EG-2I-D3E/emmc/project-spec/meta-enclustra/meta-enclustra-baseboard/conf/machine/refdes-xzu90-pe5.conf
```bitbake
#@TYPE: Machine
#@NAME: refdes-xzu90-pe5
#@DESCRIPTION: Machine configuration for the refdes-xzu90-pe5 boards.

#### Preamble
MACHINEOVERRIDES =. "${@['', 'refdes-xzu90-pe5:']['refdes-xzu90-pe5' !='${MACHINE}']}"

# Required generic machine inclusion
require conf/machine/xzu90-module.conf
require pe5-generic.conf

#### No additional settings should be after the Postamble
#### Postamble
PACKAGE_EXTRA_ARCHS:append = "${@['', 'refdes_xzu90_pe5']['refdes-xzu90-pe5' != '${MACHINE}']}"
```

## petalinux/AM-XZU65-11EG-2I-D3E/emmc/project-spec/meta-enclustra/meta-enclustra-module/conf/machine/mercury-generic.conf
```bitbake
## preamble
MACHINEOVERRIDES =. "${@['', 'mercury-generic:']['mercury-generic' != '${MACHINE}']}"

## postamble
PACKAGE_EXTRA_ARCHS:append = "${@['', ' mercury-generic']['mercury-generic' != "${MACHINE}"]}"
```

## petalinux/AM-XZU65-11EG-2I-D3E/qspi/project-spec/meta-enclustra/meta-enclustra-baseboard/conf/machine/refdes-xzu65-pe5.conf
```bitbake
#@TYPE: Machine
#@NAME: refdes-xzu65-pe5
#@DESCRIPTION: Machine configuration for the refdes-xzu65-pe5 boards.

#### Preamble
MACHINEOVERRIDES =. "${@['', 'refdes-xzu65-pe5:']['refdes-xzu65-pe5' !='${MACHINE}']}"

# Required generic machine inclusion
require conf/machine/xzu65-module.conf
require pe5-generic.conf

#### No additional settings should be after the Postamble
#### Postamble
PACKAGE_EXTRA_ARCHS:append = "${@['', 'refdes_xzu65_pe5']['refdes-xzu65-pe5' != '${MACHINE}']}"
```

## petalinux/AM-XZU65-11EG-2I-D3E/qspi/project-spec/meta-enclustra/meta-enclustra-module/conf/machine/zx2-module.conf
```bitbake
## preamble
MACHINEOVERRIDES =. "${@['', 'zx2-module:']['zx2-module' != '${MACHINE}']}"

## based on
require conf/machine/zynq-generic.conf
require conf/machine/mars-generic.conf

## postabmle
PACKAGE_EXTRA_ARCHS:append = "${@['', ' zx2_module']['zx2-module' != "${MACHINE}"]}"
```

## petalinux/AM-XZU65-11EG-2I-D3E/sd/project-spec/meta-enclustra/meta-enclustra-baseboard/conf/machine/refdes-xzu80-pe5.conf
```bitbake
#@TYPE: Machine
#@NAME: refdes-xzu80-pe5
#@DESCRIPTION: Machine configuration for the refdes-xzu80-pe5 boards.

#### Preamble
MACHINEOVERRIDES =. "${@['', 'refdes-xzu80-pe5:']['refdes-xzu80-pe5' !='${MACHINE}']}"

# Required generic machine inclusion
require conf/machine/xzu80-module.conf
require pe5-generic.conf

#### No additional settings should be after the Postamble
#### Postamble
PACKAGE_EXTRA_ARCHS:append = "${@['', 'refdes_xzu80_pe5']['refdes-xzu80-pe5' != '${MACHINE}']}"
```

## petalinux/AM-XZU65-11EG-2I-D3E/sd/project-spec/meta-enclustra/meta-enclustra-module/conf/machine/andromeda-generic.conf
```bitbake
## preamble
MACHINEOVERRIDES =. "${@['', 'andromeda-generic:']['andromeda-generic' != '${MACHINE}']}"

## postamble
PACKAGE_EXTRA_ARCHS:append = "${@['', ' andromeda-generic']['andromeda-generic' != "${MACHINE}"]}"
```

## petalinux/AM-XZU65-7EV-2I-D3E/emmc/project-spec/meta-enclustra/meta-enclustra-baseboard/conf/machine/pe5-generic.conf
```bitbake
## machine.conf for the pe5 carrier board

## preamble
MACHINEOVERRIDES =. "${@['', 'pe5-generic:']['pe5-generic' != '${MACHINE}']}"

## module based on:
#require conf/machine/zynqmp-generic.conf

## postabmle
PACKAGE_EXTRA_ARCHS:append = "${@['', ' pe5-generic']['pe5-generic' != "${MACHINE}"]}"
```

## petalinux/AM-XZU65-7EV-2I-D3E/emmc/project-spec/meta-enclustra/meta-enclustra-module/conf/machine/mars-generic.conf
```bitbake
## preamble
MACHINEOVERRIDES =. "${@['', 'mars-generic:']['mars-generic' != '${MACHINE}']}"

## postamble
PACKAGE_EXTRA_ARCHS:append = "${@['', ' mars-generic']['mars-generic' != "${MACHINE}"]}"
```
